## Documentation/devicetree/bindings/thermal/sophgo,cv1800b-thermal.yaml
```yaml
# SPDX-License-Identifier: (GPL-2.0-only OR BSD-2-Clause)
%YAML 1.2
---
$id: http://devicetree.org/schemas/thermal/sophgo,cv1800b-thermal.yaml#
$schema: http://devicetree.org/meta-schemas/core.yaml#

title: Sophgo CV1800B/SG2000 thermal sensor

maintainers:
  - Haylen Chu <heylenay@xxxxxxx>

description: |
  The Sophgo CV1800B and SG2000 SoCs integrate a temperature sensor with
  two measurement channels.  A channel reports a 13-bit raw value that is
  converted to milli-Celsius in software; high and low threshold
  violations can raise an interrupt.

  The SG2000 embeds the same sensor block, so it uses a SoC-specific
  compatible with "sophgo,cv1800b-thermal" as fallback.

$ref: thermal-sensor.yaml#

properties:
  compatible:
    oneOf:
      - const: sophgo,cv1800b-thermal
      - items:
          - const: sophgo,sg2000-thermal
          - const: sophgo,cv1800b-thermal

  reg:
    maxItems: 1

  clocks:
    maxItems: 1

  interrupts:
    maxItems: 1

  '#thermal-sensor-cells':
    const: 0

required:
  - compatible
  - reg
  - clocks
  - interrupts
  - '#thermal-sensor-cells'

unevaluatedProperties: false

examples:
  - |
    #include <dt-bindings/clock/sophgo,cv1800.h>
    #include <dt-bindings/interrupt-controller/arm-gic.h>

    thermal-sensor@30e0000 {
        compatible = "sophgo,sg2000-thermal", "sophgo,cv1800b-thermal";
        reg = <0x30e0000 0x100>;
        clocks = <&clk CLK_TEMPSEN>;
        interrupts = <GIC_SPI 0 IRQ_TYPE_LEVEL_HIGH>;
        #thermal-sensor-cells = <0>;
    };
...
```

## drivers/clk/mstar/Kconfig
```kconfig
# SPDX-License-Identifier: GPL-2.0-only
config MSTAR_MSC313_CPUPLL
	bool "MStar CPUPLL driver"
	depends on ARCH_MSTARV7 || COMPILE_TEST
	default ARCH_MSTARV7
	help
	  Support for the CPU PLL present on MStar/Sigmastar SoCs.

config MSTAR_MSC313_MPLL
	bool "MStar MPLL driver"
	depends on ARCH_MSTARV7 || COMPILE_TEST
	default ARCH_MSTARV7
	select REGMAP_MMIO
	help
	  Support for the MPLL PLL and dividers block present on
	  MStar/Sigmastar SoCs.

config MSTAR_MSC313_MUX
	bool
	select REGMAP

config MSTAR_MSC313_UPLL
	bool "MStar UPLL driver"
	depends on ARCH_MSTARV7 || COMPILE_TEST
	select REGMAP_MMIO
	help
	  Support for the USB PLL present on MStar/Sigmastar SoCs.

config MSTAR_MSC313_PM_MUXES
	bool "MStar PM region muxes driver"
	depends on ARCH_MSTARV7 || COMPILE_TEST
	select MSTAR_MSC313_MUX
	help
	  Support for the muxes embedded in the PM region.

config MSTAR_MSC313_CLKGEN
	bool "MStar CLKGEN driver"
	depends on ARCH_MSTARV7 || COMPILE_TEST
	select MSTAR_MSC313_MUX
	select REGMAP_MMIO
	help
	  Support for the main CLKGEN block.

config MSTAR_MSC313_CLKGEN_GATES
	bool "MStar CLKGEN gates driver"
	depends on ARCH_MSTARV7 || COMPILE_TEST
	help
	  Support for the simple, single-bit gate clocks in the CLKGEN
	  block. This is the older binding; newer SoCs describe their
	  gates through the CLKGEN driver instead.
```

## net/netlabel/Kconfig
```kconfig
# SPDX-License-Identifier: GPL-2.0-only
#
# NetLabel configuration
#

config NETLABEL
	bool "NetLabel subsystem support"
	depends on SECURITY
	select CRC_CCITT if IPV6
	default n
	help
	  NetLabel provides support for explicit network packet labeling
	  protocols such as CIPSO and RIPSO.  For more information see
	  Documentation/netlabel as well as the NetLabel SourceForge project
	  for configuration tools and additional documentation.

	   * https://github.com/netlabel/netlabel_tools

	  If you are unsure, say N.

config NETLABEL_CALIPSO_KUNIT_TEST
	bool "KUnit tests for NetLabel CALIPSO" if !KUNIT_ALL_TESTS
	depends on NETLABEL && IPV6 && KUNIT=y
	default KUNIT_ALL_TESTS
	help
	  Enable KUnit unit tests for NetLabel IPv6 CALIPSO option
	  encoding, decoding, and loopback validation.

	  If unsure, say N.
```
